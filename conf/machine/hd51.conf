## conf/machine/hd51.conf
```bitbake
#@TYPE: Machine
#@NAME: hd51
#@DESCRIPTION: Machine configuration for the hd51

MACHINE_FEATURES += "dvb-c textlcd qteglfs v3d-nxpl swap kodi emmc qtplugins"
OPENPLI_FEATURES += "ci"

CHIPSET = "bcm7251s"
RCTYPE = "16"

require conf/machine/include/hd-armv7ahf.inc
```

## conf/machine/include/hd-armv7ahf.inc
```bitbake
PREFERRED_VERSION_linux-hd = "4.10.12"

IMAGE_CLASSES += " hd-emmc_image_multiboot"
IMAGE_FSTYPES += " hdemmc tar"
IMAGE_ROOTFS_SIZE ?= "262144"

TARGET_ARCH = "arm"
DEFAULTTUNE = "armv7ahf-neon"

require conf/machine/include/arm/arch-armv7a.inc
require conf/machine/include/hd.inc
```
